## app/boards/arm/polilla_w/Kconfig.board
```kconfig
# Polilla wireless board configuration
#
# Copyright (c) 2020 The ZMK Contributors
# SPDX-License-Identifier: MIT

config BOARD_POLILLA_W
	bool "polilla_w"
	depends on SOC_NRF52840_QIAA
```
